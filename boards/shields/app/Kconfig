## boards/shields/app/Kconfig
```kconfig
config ZMK_TEMP_SENSOR
    bool "Enable temperature sensor support"
    depends on SENSOR
    select TEMP_NRF5
    help
      Enable temperature sensor support with Bluetooth LE service

if ZMK_TEMP_SENSOR

config ZMK_TEMP_SENSOR_UPDATE_INTERVAL
    int "Temperature sensor update interval in milliseconds"
    default 30000
    help
      How often to read and update the temperature sensor value

endif # ZMK_TEMP_SENSOR
```

## boards/shields/app/dts/bindings/behaviors/zmk,behavior-temp-sensor.yaml
```yaml
# Device tree binding for temperature sensor behavior

description: ZMK Temperature Sensor Behavior

compatible: "zmk,behavior-temp-sensor"

properties:
  sensor:
    type: phandle
    required: true
    description: Temperature sensor device phandle
    
  update-interval-ms:
    type: int
    default: 30000
    description: Temperature update interval in milliseconds
```

## boards/shields/charybdis/Kconfig.defconfig
```kconfig
if SHIELD_CHARYBDIS_RIGHT

config ZMK_KEYBOARD_NAME
	default "Alxndr"

config ZMK_SPLIT_ROLE_CENTRAL
	default y

config ZMK_TEMP_SENSOR
	default y

endif

if SHIELD_CHARYBDIS_LEFT || SHIELD_CHARYBDIS_RIGHT

config ZMK_SPLIT
	default y

config SENSOR
	default y if SHIELD_CHARYBDIS_RIGHT

config TEMP_NRF5
	default y if SHIELD_CHARYBDIS_RIGHT

endif
```

## boards/shields/charybdis/Kconfig.shield
```kconfig
config SHIELD_CHARYBDIS_LEFT
	def_bool $(shields_list_contains,charybdis_left)

config SHIELD_CHARYBDIS_RIGHT
	def_bool $(shields_list_contains,charybdis_right)

# Temperature sensor configuration
config ZMK_TEMP_SENSOR
	bool "Enable temperature sensor support"
	depends on SENSOR && (SHIELD_CHARYBDIS_RIGHT)
	select TEMP_NRF5
	default y if SHIELD_CHARYBDIS_RIGHT
	help
	  Enable temperature sensor support with Bluetooth LE service.
	  Only available on the right side (central) device.

if ZMK_TEMP_SENSOR

config ZMK_TEMP_SENSOR_UPDATE_INTERVAL
	int "Temperature sensor update interval in milliseconds"
	default 30000
	range 5000 300000
	help
	  How often to read and update the temperature sensor value.
	  Range: 5 seconds to 5 minutes.

endif # ZMK_TEMP_SENSOR
```
